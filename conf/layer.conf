## conf/layer.conf
```bitbake
BBPATH .= ":${LAYERDIR}"

BBFILES += "${LAYERDIR}/openembedded-core/meta/recipes-*/*/*.bb"
BBFILES += "${LAYERDIR}/meta-openembedded/*/recipes-*/*/*.bb"

BBFILE_COLLECTIONS += "venus-backports"
BBFILE_PATTERN_venus-backports := "^${LAYERDIR}/"
BBFILE_PRIORITY_venus-backports = "8"
BBFILE_PATTERN_IGNORE_EMPTY_venus-backports = "1"

LAYERSERIES_COMPAT_venus-backports = "scarthgap"
```
